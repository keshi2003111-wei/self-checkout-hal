#include "oled.h"

// 8x16 ASCII font
static const uint8_t font_8x16[][16] = {
    {0x00,0x00,0x00,0x00,0x00,0x00,0x00,0x00,0x00,0x00,0x00,0x00,0x00,0x00,0x00,0x00}, // space
    {0x00,0x00,0x00,0xF8,0x00,0x00,0x00,0x00,0x00,0x00,0x00,0xF8,0x00,0x00,0x00,0x00}, // !
    {0x00,0x00,0x70,0x00,0x70,0x00,0x00,0x00,0x00,0x00,0x00,0x00,0x00,0x00,0x00,0x00}, // "
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    {0x08,0x1C,0x2A,0x08,0x08,0x00,0x00,0x00,0x00,0x00,0x00,0x00,0x00,0x00,0x00,0x00}, // <-
};

// 在显示缓冲区 (128x64/8 = 1024 bytes)
static uint8_t oled_gram[OLED_WIDTH * OLED_HEIGHT / 8];

// 底层 I2C 写命令
static void OLED_WriteCmd(uint8_t cmd)
{
    uint8_t buf[2];
    buf[0] = OLED_CMD; // 0x00表示后面SSD1306第一个字节是【命令】
    buf[1] = cmd;
    /* Do not let a disconnected/busy OLED stall the whole application. */
    HAL_I2C_Master_Transmit(&hi2c1, OLED_ADDR, buf, 2, 2);
}

// 底层 I2C 写数据字节
static void OLED_WriteData(uint8_t data)
{
    uint8_t buf[2];
    buf[0] = OLED_DATA; //0x40表示后面一个字节是数据
    buf[1] = data;
    HAL_I2C_Master_Transmit(&hi2c1, OLED_ADDR, buf, 2, 2);
}

// 设置光标位置（页地址模式）
void OLED_SetCursor(uint8_t page, uint8_t column)
{
    OLED_WriteCmd(0xB0 + page);                    // 设置页地址 0xB0~0xB7
    OLED_WriteCmd(0x00 + (column & 0x0F));         // 列地址低4位
    OLED_WriteCmd(0x10 + ((column >> 4) & 0x0F));  // 列地址高4位
}

// 初始化
void OLED_Init(void)
{
    HAL_Delay(100);

    OLED_WriteCmd(0xAE); // 关闭显示
    OLED_WriteCmd(0xD5); // 时钟分频
    OLED_WriteCmd(0x80);
    OLED_WriteCmd(0xA8); // 多路复用
    OLED_WriteCmd(0x3F); // 1/64 duty 128*64屏幕固定0x3F
    OLED_WriteCmd(0xD3); // 显示偏移
    OLED_WriteCmd(0x00);
    OLED_WriteCmd(0x40); // 显示起始行
    OLED_WriteCmd(0x8D); // Charge pump
    OLED_WriteCmd(0x14);
    OLED_WriteCmd(0x20); // Memory address mode
    OLED_WriteCmd(0x00); // Horizontal
    OLED_WriteCmd(0xA1); // Segment remap
    OLED_WriteCmd(0xC8); // COM scan direction
    OLED_WriteCmd(0xDA); // COM pins hardware configuration
    OLED_WriteCmd(0x12);
    OLED_WriteCmd(0x81); // Contrast control
    OLED_WriteCmd(0xCF);
    OLED_WriteCmd(0xD9); // Pre-charge period
    OLED_WriteCmd(0xF1);
    OLED_WriteCmd(0xDB); // VCOMH deselect level
    OLED_WriteCmd(0x40);
    OLED_WriteCmd(0xA4); // Entire display ON
    OLED_WriteCmd(0xA6); // Normal display
    OLED_WriteCmd(0xAF); // Display ON

    OLED_Clear();
}

// 清屏
void OLED_Clear(void)
{
    uint8_t i, j;
    for (i = 0; i < OLED_PAGES; i++)
    {
        OLED_SetCursor(i, 0);
        for (j = 0; j < OLED_WIDTH; j++)
        {
            OLED_WriteData(0x00); // 0x00全部熄灭
        }
    }
    memset(oled_gram, 0, sizeof(oled_gram));
}

// 在指定页面和列显示单个8x16字符
void OLED_ShowChar(uint8_t page, uint8_t column, char ch)
{
    uint8_t i, c;
    uint8_t page0 = page, page1 = page + 1; //8x16字符占两页
    if (ch < ' ' || ch > '~') ch = ' '; //只打印可打印ASCII字符，非法字符显示空格
    c = ch - ' ';  //字符转相应索引
    OLED_SetCursor(page0, column);
    for (i = 0; i < 8; i++)
    {
        OLED_WriteData(font_8x16[c][i]); //显示字符上半8字节
    }

    OLED_SetCursor(page1, column);
    for (i = 0; i < 8; i++)
    {
        OLED_WriteData(font_8x16[c][i + 8]); //显示字符下半8字节
    }
}

// 显示字符串
void OLED_ShowString(uint8_t page, uint8_t column, char *str)
{
    while (*str)
    {
        OLED_ShowChar(page, column, *str);
        str++;
        column += 8; //一个字符占8个列宽度
        if (column > (OLED_WIDTH - 8))
        {
            column = 0;
            page += 2; //换行，每行占2页（16像素）
            if (page > (OLED_PAGES - 2))
            {
                page = 0; //超出屏幕范围重新最顶部
            }
        }
    }
}

// 显示整数
void OLED_ShowNum(uint8_t page, uint8_t column, int32_t num, uint8_t len)
{
    char buf[12];
    uint8_t i;

    if (num < 0)
    {
        OLED_ShowChar(page, column, '-');
        column += 8;
        num = -num;
        len--;
    }

    for (i = len; i > 0; i--)
    {
        buf[i - 1] = '0' + (num % 10);
        num /= 10;
    }
    buf[len] = '\0';

    OLED_ShowString(page, column, buf);
}

// Update display from GRAM buffer
void OLED_Update(void)
{
    uint8_t i, j;
    for (i = 0; i < OLED_PAGES; i++)
    {
        OLED_SetCursor(i, 0);
        for (j = 0; j < OLED_WIDTH; j++)
        {
            OLED_WriteData(oled_gram[i * OLED_WIDTH + j]);
        }
    }
}

void OLED_Showf(uint8_t page, uint8_t column, const char *fmt, ...)
{
    char buf[64];
    va_list args;
    va_start(args, fmt);
    vsnprintf(buf, sizeof(buf), fmt, args);
    va_end(args);
    OLED_ShowString(page, column, buf);
}
